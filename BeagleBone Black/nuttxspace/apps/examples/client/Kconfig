## BeagleBone Black/nuttxspace/apps/examples/client/Kconfig
```kconfig
config EXAMPLES_CLIENT
	tristate "Client Application"
	default n
	---help---
		Enable the custom client network application.

if EXAMPLES_CLIENT

config EXAMPLES_CLIENT_PROGNAME
	string "Program name"
	default "client"
	---help---
		This is the name of the program that will be used when the NSH ELF
		program is installed.

config EXAMPLES_CLIENT_PRIORITY
	int "Client task priority"
	default 100

config EXAMPLES_CLIENT_STACKSIZE
	int "Client stack size"
	default 2048

endif
```

## BeagleBone Black/nuttxspace/apps/examples/my_client/Kconfig
```kconfig
config EXAMPLES_MY_CLIENT
	tristate "My Client Application"
	default n
	---help---
		Enable the custom client network application.

if EXAMPLES_MY_CLIENT

config EXAMPLES_MY_CLIENT_PROGNAME
	string "Program name"
	default "my_client"
	---help---
		This is the name of the program that will be used when the NSH ELF
		program is installed.

config EXAMPLES_MY_CLIENT_PRIORITY
	int "Client task priority"
	default 100

config EXAMPLES_MY_CLIENT_STACKSIZE
	int "Client stack size"
	default 2048

endif
```

## BeagleBone Black/nuttxspace/apps/examples/my_server/Kconfig
```kconfig
config EXAMPLES_MY_SERVER
	tristate "My Server Application"
	default n
	---help---
		Enable the custom server network application.

if EXAMPLES_MY_SERVER

config EXAMPLES_MY_SERVER_PROGNAME
	string "Program name"
	default "my_server"
	---help---
		This is the name of the program that will be used when the NSH ELF
		program is installed.

config EXAMPLES_MY_SERVER_PRIORITY
	int "Server task priority"
	default 100

config EXAMPLES_MY_SERVER_STACKSIZE
	int "Server stack size"
	default 2048

endif
```

## BeagleBone Black/nuttxspace/apps/examples/my_udp_client/Kconfig
```kconfig
config EXAMPLES_MY_UDP_CLIENT
	tristate "My UDP Client Application"
	default n
	---help---
		Enable the custom UDP client network application.

if EXAMPLES_MY_UDP_CLIENT

config EXAMPLES_MY_UDP_CLIENT_PROGNAME
	string "Program name"
	default "my_udp_client"
	---help---
		This is the name of the program that will be used when the NSH ELF
		program is installed.

config EXAMPLES_MY_UDP_CLIENT_PRIORITY
	int "Client task priority"
	default 100

config EXAMPLES_MY_UDP_CLIENT_STACKSIZE
	int "Client stack size"
	default 4096

endif
```
